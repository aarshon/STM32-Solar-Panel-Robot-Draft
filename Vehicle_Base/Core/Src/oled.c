/*
 * oled.c  —  SSD1306 128x64 OLED, I2C driver
 * Board : STM32 Nucleo-F767ZI  (Vehicle Base)
 *
 * Uses page-addressing mode.  Each page = 8 pixel rows.
 * Font is 5x8 (5 columns wide, 1 page tall) + 1 column spacing = 6px/char.
 * That gives 21 characters per row, 8 rows total.
 * OLED_WriteStatus uses page 0 (line1) and page 2 (line2) for readability.
 */

#include "oled.h"
#include <string.h>
#include <stdio.h>

/* =========================================================================
 * 5x8 ASCII font — characters 0x20 (space) through 0x7E (~)
 * Each entry is 5 bytes representing pixel columns, LSB = top pixel.
 * ========================================================================= */
static const uint8_t font5x8[][5] = {
    {0x00,0x00,0x00,0x00,0x00}, /* 0x20  ' ' */
    {0x00,0x00,0x5F,0x00,0x00}, /* 0x21  '!' */
    {0x00,0x07,0x00,0x07,0x00}, /* 0x22  '"' */
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    {0x10,0x08,0x08,0x10,0x08}, /* 0x7E  '~' */
};

/* =========================================================================
 * Low-level I2C helpers
 * ========================================================================= */

/* Send a single command byte */
static void ssd1306_cmd(uint8_t cmd)
{
    uint8_t buf[2] = { 0x00, cmd };   /* 0x00 = control byte: command */
    HAL_I2C_Master_Transmit(&OLED_I2C, OLED_I2C_ADDR << 1, buf, 2, 10);
}

/* Send a buffer of data bytes (pixel data) */
static void ssd1306_data(const uint8_t *data, uint16_t len)
{
    /* Prepend the data control byte 0x40 */
    uint8_t buf[129];                 /* 1 control byte + up to 128 data bytes */
    if (len > 128) len = 128;
    buf[0] = 0x40;
    memcpy(&buf[1], data, len);
    HAL_I2C_Master_Transmit(&OLED_I2C, OLED_I2C_ADDR << 1, buf, len + 1, 50);
}

/* =========================================================================
 * Cursor — set page (row 0-7) and pixel column (0-127)
 * ========================================================================= */
static void set_cursor(uint8_t page, uint8_t col)
{
    ssd1306_cmd(0xB0 | (page & 0x07));          /* Set page address        */
    ssd1306_cmd(0x00 | (col & 0x0F));           /* Lower column nibble     */
    ssd1306_cmd(0x10 | (col >> 4));             /* Upper column nibble     */
}

/* =========================================================================
 * Public API
 * ========================================================================= */

void OLED_Init(void)
{
    HAL_Delay(100);   /* Let the display power up                            */

    static const uint8_t init_seq[] = {
        0xAE,         /* Display OFF                                         */
        0xD5, 0x80,   /* Clock divide ratio / oscillator frequency           */
        0xA8, 0x3F,   /* Multiplex ratio: 64 rows (0x3F = 63)               */
        0xD3, 0x00,   /* Display offset: 0                                   */
        0x40,         /* Start line: 0                                       */
        0x8D, 0x14,   /* Charge pump: enable                                 */
        0x20, 0x02,   /* Memory addressing mode: page addressing             */
        0xA1,         /* Segment re-map: col 127 mapped to SEG0              */
        0xC8,         /* COM scan direction: remapped (top-to-bottom)        */
        0xDA, 0x12,   /* COM pins hardware config: alt, no remap             */
        0x81, 0xCF,   /* Contrast: 0xCF                                      */
        0xD9, 0xF1,   /* Pre-charge period                                   */
        0xDB, 0x40,   /* VCOMH deselect level                                */
        0xA4,         /* Entire display on: follow RAM content               */
        0xA6,         /* Normal display (not inverted)                       */
        0xAF,         /* Display ON                                          */
    };

    for (uint8_t i = 0; i < sizeof(init_seq); i++) {
        ssd1306_cmd(init_seq[i]);
    }

    OLED_Clear();
}

void OLED_Clear(void)
{
    uint8_t blank[OLED_WIDTH];
    memset(blank, 0x00, sizeof(blank));

    for (uint8_t page = 0; page < OLED_PAGES; page++) {
        set_cursor(page, 0);
        ssd1306_data(blank, OLED_WIDTH);
    }
}

void OLED_SetCursor(uint8_t page, uint8_t col)
{
    set_cursor(page, col);
}

/* Write a null-terminated string at the current cursor position.
 * Each character is 6 pixels wide (5 font cols + 1 blank col). */
void OLED_Print(const char *str)
{
    while (*str)
    {
        uint8_t ch = (uint8_t)*str++;
        uint8_t glyph[6];

        if (ch >= 0x20 && ch <= 0x7E) {
            memcpy(glyph, font5x8[ch - 0x20], 5);
        } else {
            memset(glyph, 0x00, 5);   /* Unknown char → blank              */
        }
        glyph[5] = 0x00;              /* 1-pixel column gap between chars  */

        ssd1306_data(glyph, 6);
    }
}

/* Write two status lines.
 * line1 appears on page 0 (top), line2 on page 2 (below with spacing).
 * Each line is padded/truncated to 21 characters (128px / 6px per char). */
void OLED_WriteStatus(const char *line1, const char *line2)
{
    char buf[22];   /* 21 chars + null */

    set_cursor(0, 0);
    snprintf(buf, sizeof(buf), "%-21s", line1);
    OLED_Print(buf);

    set_cursor(2, 0);
    snprintf(buf, sizeof(buf), "%-21s", line2);
    OLED_Print(buf);
}
